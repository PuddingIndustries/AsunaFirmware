## main/Kconfig.projbuild
```kconfig
menu "Application Specific Configuration"
    config APP_NETIF_LTE_RST_GPIO
        int "LTE module RST pin number"
        default 7
        help
            Select the RST pin number for LTE module.

    config APP_NETIF_LTE_TX_GPIO
        int "LTE module TX pin number"
        default 17
        help
            Select the TX pin number for LTE module.

    config APP_NETIF_LTE_RX_GPIO
        int "LTE module RX pin number"
        default 18
        help
            Select the RX pin number for LTE module.

    config APP_GNSS_SERVER_TX_GPIO
        int "GNSS module TX pin number"
        default 43
        help
            Select the TX pin number for GNSS module.

    config APP_GNSS_SERVER_RX_GPIO
        int "GNSS module RX pin number"
        default 44
        help
            Select the RX pin number for GNSS module.

    config APP_GNSS_SERVER_RST_GPIO
        int "GNSS module RST pin number"
        default 2
        help
            Select the RST pin number for GNSS module.

    config APP_GNSS_SERVER_PPS_GPIO
        int "GNSS module PPS pin number"
        default 1
        help
            Select the PPS pin number for GNSS module.

endmenu
```

## sdkconfig.defaults
```kconfig
CONFIG_IDF_TARGET="esp32s3"

# Flash selection
CONFIG_ESPTOOLPY_FLASHSIZE_8MB=y

# Custom partition table
CONFIG_PARTITION_TABLE_CUSTOM=y
CONFIG_PARTITION_TABLE_CUSTOM_FILENAME="partitions_ota.csv"

# Debug Console
CONFIG_ESP_CONSOLE_USB_SERIAL_JTAG=y

# FreeRTOS
CONFIG_FREERTOS_GENERATE_RUN_TIME_STATS=y

# HTTP Server
CONFIG_HTTPD_MAX_REQ_HDR_LEN=2048
CONFIG_HTTPD_WS_SUPPORT=y

# LwIP
CONFIG_LWIP_SO_LINGER=y

# UART Driver
CONFIG_UART_ISR_IN_IRAM=y
```
